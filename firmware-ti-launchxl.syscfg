/*
 * Copyright (c) 2018-2019, Texas Instruments Incorporated
 * All rights reserved.
 *
 * Redistribution and use in source and binary forms, with or without
 * modification, are permitted provided that the following conditions
 * are met:
 *
 * *  Redistributions of source code must retain the above copyright
 *    notice, this list of conditions and the following disclaimer.
 *
 * *  Redistributions in binary form must reproduce the above copyright
 *    notice, this list of conditions and the following disclaimer in the
 *    documentation and/or other materials provided with the distribution.
 *
 * *  Neither the name of Texas Instruments Incorporated nor the names of
 *    its contributors may be used to endorse or promote products derived
 *    from this software without specific prior written permission.
 *
 * THIS SOFTWARE IS PROVIDED BY THE COPYRIGHT HOLDERS AND CONTRIBUTORS "AS IS"
 * AND ANY EXPRESS OR IMPLIED WARRANTIES, INCLUDING, BUT NOT LIMITED TO,
 * THE IMPLIED WARRANTIES OF MERCHANTABILITY AND FITNESS FOR A PARTICULAR
 * PURPOSE ARE DISCLAIMED. IN NO EVENT SHALL THE COPYRIGHT OWNER OR
 * CONTRIBUTORS BE LIABLE FOR ANY DIRECT, INDIRECT, INCIDENTAL, SPECIAL,
 * EXEMPLARY, OR CONSEQUENTIAL DAMAGES (INCLUDING, BUT NOT LIMITED TO,
 * PROCUREMENT OF SUBSTITUTE GOODS OR SERVICES; LOSS OF USE, DATA, OR PROFITS;
 * OR BUSINESS INTERRUPTION) HOWEVER CAUSED AND ON ANY THEORY OF LIABILITY,
 * WHETHER IN CONTRACT, STRICT LIABILITY, OR TORT (INCLUDING NEGLIGENCE OR
 * OTHERWISE) ARISING IN ANY WAY OUT OF THE USE OF THIS SOFTWARE,
 * EVEN IF ADVISED OF THE POSSIBILITY OF SUCH DAMAGE.
 */
// @cliArgs --board /ti/boards/CC1352P1_LAUNCHXL

/*
 *  firmware-ti-launchxl.syscfg
 */

/* ======== Sensors BoosterPack ======== */
var Sensors = scripting.addHardware("boostxl_sensors/BOOSTXL-SENSORS");

/* ======== RTOS ======== */
var RTOS = scripting.addModule("/ti/drivers/RTOS");
RTOS.name = "FreeRTOS";

/* ======== GPIO ======== */
var GPIO = scripting.addModule("/ti/drivers/GPIO");
var gpio = GPIO.addInstance();
gpio.$hardware = system.deviceData.board.components.LED0;
gpio.$name = "CONFIG_GPIO_LED_0";

var gpio3 = GPIO.addInstance();
gpio3.$hardware = system.deviceData.board.components.LED1;
gpio3.$name = "CONFIG_GPIO_LED_1";

/* ======== UART ======== */
var UART2 = scripting.addModule("/ti/drivers/UART2");
var uart2 = UART2.addInstance();
uart2.$hardware = system.deviceData.board.components.XDS110UART;
uart2.$name = "CONFIG_UART2_0";

/* ======== Timer ======== */
var Timer = scripting.addModule("/ti/drivers/Timer");
var timer = Timer.addInstance();
timer.timerType = "32 Bits";
timer.$name = "CONFIG_TIMER_0";

/* ======== I2C ======== */
var I2C = scripting.addModule("/ti/drivers/I2C");
var i2c = I2C.addInstance();
i2c.$name = "CONFIG_I2C_0";
i2c.$hardware = Sensors.components.BMI160_BMM150.subComponents.I2C;
//i2c.i2c.sdaPin.$assign = "boosterpack.10";
//i2c.i2c.sclPin.$assign = "boosterpack.9";

/* ======== I2S ======== */
var I2S = scripting.addModule("/ti/drivers/I2S");
var i2s = I2S.addInstance();
i2s.interruptPriority = "2";
i2s.$name = "CONFIG_I2S_0";
/*
    * All CC13x2 LaunchPads must jumper SD0/DIN as this conflicts with the
    * sub-1 GHz RF port.
    */
i2s.i2s.SD0Pin.$assign = "DIO25";               // CC3200AUDBOOST DIN
/*
    * "P" variant LaunchPads must use jumpers for all I2S signals because
    * there are conflicts between the I2S pins required by the BoosterPack
    * and the RF ports and the RF switch signals on the LaunchPad
    */
i2s.i2s.SD1Pin.$assign = "DIO26";           // CC3200AUDBOOST DOUT
i2s.i2s.SCKPin.$assign = "DIO27";           // CC3200AUDBOOST BCLK
i2s.i2s.WSPin.$assign =  "DIO16";           // CC3200AUDBOOST FSYNC

/* ======== NVS ======== */
var NVS = scripting.addModule("/ti/drivers/NVS");
var nvs = NVS.addInstance();
nvs.$hardware = system.deviceData.board.components.SPI_FLASH;
nvs.$name = "CONFIG_NVSEXTERNAL";
